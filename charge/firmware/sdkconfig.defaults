## charge/firmware/sdkconfig.defaults
```kconfig
# ---- Target ----
CONFIG_IDF_TARGET="esp32"

# ---- Flash ----
CONFIG_ESPTOOLPY_FLASHSIZE_4MB=y
CONFIG_ESPTOOLPY_FLASHMODE_DIO=y
CONFIG_ESPTOOLPY_FLASHFREQ_40M=y

# ---- FreeRTOS ----
CONFIG_FREERTOS_HZ=1000
CONFIG_FREERTOS_USE_TRACE_FACILITY=y

# ---- UART ----
CONFIG_ESP_CONSOLE_UART_DEFAULT=y
CONFIG_ESP_CONSOLE_UART_BAUDRATE=115200

# ---- Watchdog ----
CONFIG_ESP_TASK_WDT_EN=y
CONFIG_ESP_TASK_WDT_TIMEOUT_S=5
CONFIG_ESP_TASK_WDT_PANIC=y

# ---- Log ----
CONFIG_LOG_DEFAULT_LEVEL_INFO=y
```
